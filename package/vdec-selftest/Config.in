## package/vdec-selftest/Config.in
```kconfig
config BR2_PACKAGE_VDEC_SELFTEST
	bool "vdec-selftest / mp4play"
	depends on BR2_TOOLCHAIN_HAS_THREADS
	depends on !BR2_STATIC_LIBS # tinyalsa
	select BR2_PACKAGE_LIBDRM
	select BR2_PACKAGE_LIBDRM_ENABLE_ATOMIC
	select BR2_PACKAGE_TINYALSA
	select BR2_PACKAGE_FAAD2
	help
	  Standalone H.264 decoder bring-up tool and MP4 player for the
	  Allwinner suniv Cedar video engine (cedrus V4L2 M2M).

	  vdec_selftest reads an MP4 file, decodes the H.264 video track
	  through /dev/video0, and displays the decoded tiled NV12 frames
	  through a DRM plane.

	  mp4play adds the AAC audio track (faad2 -> tinyalsa) and plays
	  the file with audio-mastered A/V sync.

	  https://github.com/rhodesepass/drm_app_neo
```
